## CMakeLists.txt
```
cmake_minimum_required(VERSION 3.20.0)

find_package(Zephyr REQUIRED HINTS $ENV{ZEPHYR_BASE})
project(app_lora_rak3172)

target_sources(app PRIVATE
  src/main.c
  src/payload.c
  src/hmac.c
)
```

## prj.conf
```kconfig
# =========================================================
# Basic console & logging
# =========================================================
CONFIG_PRINTK=y

CONFIG_LOG=y
CONFIG_LOG_MODE_DEFERRED=y
CONFIG_LOG_DEFAULT_LEVEL=3

CONFIG_CONSOLE=y
CONFIG_UART_CONSOLE=y


# =========================================================
# Memory / stack configuration
# =========================================================
CONFIG_MAIN_STACK_SIZE=2048
CONFIG_HEAP_MEM_POOL_SIZE=2048
CONFIG_SYSTEM_WORKQUEUE_STACK_SIZE=2048


# =========================================================
# Entropy (OTAA nonce + random)
# =========================================================
CONFIG_ENTROPY_GENERATOR=y


# =========================================================
# LoRa / LoRaWAN configuration (RAK3172)
# =========================================================
CONFIG_LORA=y
CONFIG_LORAWAN=y
CONFIG_LORAMAC_REGION_EU868=y

# LoRaWAN context persistence (dev_nonce + LoRaMac state/counters)
CONFIG_LORAWAN_NVM_SETTINGS=y


# =========================================================
# Persistent storage backend (Settings + NVS)
# =========================================================
CONFIG_FLASH=y
CONFIG_FLASH_MAP=y
CONFIG_NVS=y
CONFIG_SETTINGS=y


# =========================================================
# Watchdog
# =========================================================
CONFIG_WATCHDOG=y


# =========================================================
# mbedTLS (HMAC-SHA256 için – Zephyr uyumlu)
# =========================================================
CONFIG_MBEDTLS=y
CONFIG_MBEDTLS_MD_C=y


# =========================================================
# Safety / build hygiene
# =========================================================
CONFIG_ASSERT=y
```

## src/main.c
```c
#include <zephyr/kernel.h>
#include <zephyr/logging/log.h>
#include <zephyr/lorawan/lorawan.h>
#include <zephyr/random/random.h>
#include <zephyr/device.h>
#include <zephyr/drivers/watchdog.h>

#include "lorawan_keys.h"
#include "payload.h"
#include "hmac.h"

LOG_MODULE_REGISTER(app, LOG_LEVEL_INF);

/* =========================================================
 * Sabitler
 * ========================================================= */
#define LORAWAN_APP_PORT        1
#define TX_INTERVAL_SECONDS     600

#define JOIN_RETRY_INTERVAL_MS  60000
#define JOIN_MAX_RETRIES        10

#define UPLINK_MAX_RETRIES      3
#define UPLINK_RETRY_DELAY_MS   5000

#define TEMP_MIN_C              -40.0f
#define TEMP_MAX_C               85.0f
#define HUM_MIN_PERCENT           0.0f
#define HUM_MAX_PERCENT         100.0f

/* Watchdog timeout (ms) */
#define WDT_TIMEOUT_MS          15000

/* =========================================================
 * Watchdog init
 * ========================================================= */
static const struct device *wdt_dev;
static int wdt_channel_id = -1;

static void watchdog_init(void)
{
#if DT_HAS_ALIAS(wdt0)
    wdt_dev = DEVICE_DT_GET(DT_ALIAS(wdt0));
#elif DT_NODE_HAS_STATUS(DT_NODELABEL(iwdg), okay)
    wdt_dev = DEVICE_DT_GET(DT_NODELABEL(iwdg));
#else
    wdt_dev = NULL;
#endif

    if (!wdt_dev || !device_is_ready(wdt_dev)) {
        LOG_WRN("Watchdog device not ready / not found (continuing without WDT)");
        return;
    }

    struct wdt_timeout_cfg cfg = {
        .window = {
            .min = 0,
            .max = WDT_TIMEOUT_MS,
        },
        .flags = WDT_FLAG_RESET_SOC,
    };

    wdt_channel_id = wdt_install_timeout(wdt_dev, &cfg);
    if (wdt_channel_id < 0) {
        LOG_WRN("wdt_install_timeout failed (%d), continuing without WDT", wdt_channel_id);
        wdt_channel_id = -1;
        return;
    }

    int ret = wdt_setup(wdt_dev, 0);
    if (ret < 0) {
        LOG_WRN("wdt_setup failed (%d), continuing without WDT", ret);
        wdt_channel_id = -1;
        return;
    }

    LOG_INF("Watchdog enabled (timeout=%d ms)", WDT_TIMEOUT_MS);
}

static inline void watchdog_feed(void)
{
    if (wdt_dev && (wdt_channel_id >= 0)) {
        (void)wdt_feed(wdt_dev, wdt_channel_id);
    }
}

/* =========================================================
 * Random float (1 ondalık)
 * ========================================================= */
static float random_float_1dp(float min, float max)
{
    uint32_t r = sys_rand32_get() % 1001;
    float value = min + ((float)r / 1000.0f) * (max - min);
    return ((int)(value * 10.0f + 0.5f)) / 10.0f;
}

int main(void)
{
    int ret;

    LOG_INF("======================================");
    LOG_INF(" app_lora_rak3172 starting");
    LOG_INF("======================================");

    watchdog_init();

    /* LoRaWAN start:
       - CONFIG_LORAWAN_NVM_SETTINGS=y ise daha önceki context/settings varsa restore eder. */
    ret = lorawan_start();
    if (ret < 0) {
        LOG_ERR("lorawan_start failed: %d", ret);
        return 0;
    }

    /* Confirmed mesaj retry sayısını stack’e bildir */
    (void)lorawan_set_conf_msg_tries(UPLINK_MAX_RETRIES);

    struct lorawan_join_config join_cfg = { 0 };
    join_cfg.mode = LORAWAN_ACT_OTAA;
    join_cfg.dev_eui        = (uint8_t *)LORAWAN_DEVICE_EUI;
    join_cfg.otaa.join_eui  = (uint8_t *)LORAWAN_JOIN_EUI;
    join_cfg.otaa.app_key   = (uint8_t *)LORAWAN_APP_KEY;

    bool joined = false;

    for (int i = 1; i <= JOIN_MAX_RETRIES; i++) {
        watchdog_feed();
        LOG_INF("Join attempt %d/%d", i, JOIN_MAX_RETRIES);

        ret = lorawan_join(&join_cfg);
        if (ret == 0) {
            LOG_INF("Join successful");
            joined = true;
            break;
        }

        LOG_WRN("Join failed (%d), retry in %d ms",
                ret, JOIN_RETRY_INTERVAL_MS);
        k_sleep(K_MSEC(JOIN_RETRY_INTERVAL_MS));
    }

    while (1) {
        watchdog_feed();

        float temperature = random_float_1dp(TEMP_MIN_C, TEMP_MAX_C);
        float humidity    = random_float_1dp(HUM_MIN_PERCENT, HUM_MAX_PERCENT);

        LOG_INF("Sensor data: T=%.1f C, H=%.1f %%",
                (double)temperature,
                (double)humidity);

        char data_part[DATA_PART_MAX_SIZE];
        size_t data_len;

        if (!payload_build_data_part(temperature, humidity,
                                     data_part, &data_len)) {
            goto sleep;
        }

        uint8_t hmac_bin[HMAC_SHA256_SIZE_BYTES];
        char hmac_hex[HMAC_SHA256_HEX_SIZE + 1];

        hmac_sha256_compute(
            (const uint8_t *)"SensecapStm32WL55SecretKey2024",
            32,
            (const uint8_t *)data_part,
            data_len,
            hmac_bin);

        bytes_to_hex_string(hmac_bin,
                            HMAC_SHA256_SIZE_BYTES,
                            hmac_hex,
                            sizeof(hmac_hex));

        char final_payload[PAYLOAD_MAX_SIZE];
        size_t final_len;

        payload_build_final(data_part,
                            hmac_hex,
                            final_payload,
                            &final_len);

        if (joined) {
            /* Confirmed uplink */
            ret = lorawan_send(LORAWAN_APP_PORT,
                               (uint8_t *)final_payload,
                               (uint8_t)final_len,
                               LORAWAN_MSG_CONFIRMED);

            if (ret == 0) {
                LOG_INF("Uplink sent");
            } else {
                LOG_WRN("Uplink failed (%d)", ret);
            }
        }

sleep:
        k_sleep(K_SECONDS(TX_INTERVAL_SECONDS));
    }

    return 0;
}
```

## src/hmac.c
```c
#include "hmac.h"

#include <string.h>
#include <mbedtls/md.h>

/* =========================================================
 * Dokümana göre TEST anahtarı (4.1)
 *
 * Üretimde plaintext saklanmamalıdır (doküman uyarısı).
 * ========================================================= */
static const char HMAC_SECRET_KEY_STR[] = "SensecapStm32WL55SecretKey2024";
#define HMAC_KEY_SIZE 32

bool hmac_sha256_compute(const uint8_t *key,
                         size_t key_len,
                         const uint8_t *data,
                         size_t data_len,
                         uint8_t out_hash[HMAC_SHA256_SIZE_BYTES])
{
    if (!key || !data || !out_hash) {
        return false;
    }

    const mbedtls_md_info_t *md_info = mbedtls_md_info_from_type(MBEDTLS_MD_SHA256);
    if (md_info == NULL) {
        return false;
    }

    int ret = mbedtls_md_hmac(md_info,
                             key, key_len,
                             data, data_len,
                             out_hash);

    return (ret == 0);
}

bool bytes_to_hex_string(const uint8_t *bytes,
                         size_t len,
                         char *out_hex,
                         size_t out_size)
{
    static const char hex_chars[] = "0123456789abcdef";

    if (!bytes || !out_hex) {
        return false;
    }

    if (out_size < (2 * len + 1)) {
        return false;
    }

    for (size_t i = 0; i < len; i++) {
        out_hex[2 * i]     = hex_chars[(bytes[i] >> 4) & 0x0F];
        out_hex[2 * i + 1] = hex_chars[bytes[i] & 0x0F];
    }

    out_hex[2 * len] = '\0';
    return true;
}

/* =========================================================
 * (Opsiyonel) Dokümandaki kullanım desenini kolaylaştıran helper
 *
 * Şimdilik main.c tarafından kullanılmıyor.
 * İleride payload ile birleştirilecektir.
 * ========================================================= */
bool hmac_sha256_compute_doc_key(const uint8_t *data,
                                 size_t data_len,
                                 uint8_t out_hash[HMAC_SHA256_SIZE_BYTES])
{
    return hmac_sha256_compute((const uint8_t *)HMAC_SECRET_KEY_STR,
                               HMAC_KEY_SIZE,
                               data,
                               data_len,
                               out_hash);
}
```

## src/hmac.h
```c
#pragma once
#include <stdbool.h>
#include <stddef.h>
#include <stdint.h>

/* =========================================================
 * 4. GÜVENLİK (HMAC-SHA256)
 *
 * - HMAC çıktısı : 32 byte
 * - Hex string   : 64 karakter (null terminator hariç)
 * ========================================================= */

#define HMAC_SHA256_SIZE_BYTES   32
#define HMAC_SHA256_HEX_SIZE     64   /* 32 byte -> 64 hex karakter */

/**
 * @brief HMAC-SHA256 hesaplar
 *
 * @param key       Secret key bytes
 * @param key_len   Key length
 * @param data      Input data bytes
 * @param data_len  Input length
 * @param out_hash  Output buffer (32 bytes)
 * @return true     Başarılı
 * @return false    Hata
 */
bool hmac_sha256_compute(const uint8_t *key,
                         size_t key_len,
                         const uint8_t *data,
                         size_t data_len,
                         uint8_t out_hash[HMAC_SHA256_SIZE_BYTES]);

/**
 * @brief Binary -> hex string (küçük harf)
 *
 * @param bytes     Input binary
 * @param len       Input length
 * @param out_hex   Output buffer (en az 2*len + 1)
 * @param out_size  Output buffer size
 * @return true     Başarılı
 * @return false    Hata
 */
bool bytes_to_hex_string(const uint8_t *bytes,
                         size_t len,
                         char *out_hex,
                         size_t out_size);
```

## src/lorawan_keys_example.h
```c
#pragma once
#include <stdint.h>

static const uint8_t LORAWAN_DEVICE_EUI[8] = {0};
static const uint8_t LORAWAN_JOIN_EUI[8]   = {0};
static const uint8_t LORAWAN_APP_KEY[16]   = {0};
```

## src/payload.c
```c
#include "payload.h"
#include <stdio.h>
#include <string.h>

/* =========================================================
 * Payload data part: "T:%.1f,H:%.1f"
 * ========================================================= */
bool payload_build_data_part(float temperature,
                             float humidity,
                             char *out_buf,
                             size_t *out_len)
{
    if (!out_buf || !out_len) {
        return false;
    }

    int len = snprintf(out_buf,
                       DATA_PART_MAX_SIZE,
                       "T:%.1f,H:%.1f",
                       (double)temperature,
                       (double)humidity);

    if (len <= 0 || len >= DATA_PART_MAX_SIZE) {
        return false;
    }

    *out_len = (size_t)len;
    return true;
}

/* =========================================================
 * Final payload: "T:%.1f,H:%.1f#<64hex>"
 * ========================================================= */
bool payload_build_final(const char *data_part,
                          const char *hmac_hex,
                          char *out_buf,
                          size_t *out_len)
{
    if (!data_part || !hmac_hex || !out_buf || !out_len) {
        return false;
    }

    if (strlen(hmac_hex) != HMAC_HEX_SIZE) {
        return false;
    }

    int len = snprintf(out_buf,
                       PAYLOAD_MAX_SIZE,
                       "%s#%s",
                       data_part,
                       hmac_hex);

    if (len <= 0 || len >= PAYLOAD_MAX_SIZE) {
        return false;
    }

    *out_len = (size_t)len;
    return true;
}
```

## src/payload.h
```c
#pragma once
#include <stdbool.h>
#include <stddef.h>
#include <stdint.h>

/* =========================================================
 * 3. APPLICATION PAYLOAD FORMAT (Dok?mana birebir)
 *
 * Data Part : "T:%.1f,H:%.1f"
 * Delimiter : "#"
 * HMAC Part : 64 hex char (32 byte SHA256)
 *
 * Final     : "T:25.3,H:60.5#<64hex>"
 * ========================================================= */

#define TEMP_FORMAT_STRING      "T:%.1f"
#define HUM_FORMAT_STRING       "H:%.1f"
#define PAYLOAD_FORMAT_STRING  "T:%.1f,H:%.1f#%s"

/* Boyut s?n?rlar? (dok?mana g?re) */
#define DATA_PART_MAX_SIZE      32
#define HMAC_HEX_SIZE           64
#define PAYLOAD_MAX_SIZE        128

/* =========================================================
 * API
 * ========================================================= */

/**
 * @brief Payload olu?turur (HMAC hari?)
 *
 * @param temperature   S?cakl?k (?C)
 * @param humidity      Nem (%)
 * @param out_buf       ??k?? buffer
 * @param out_len       ??k?? uzunlu?u
 * @return true         Ba?ar?l?
 * @return false        Hata
 */
bool payload_build_data_part(float temperature,
                             float humidity,
                             char *out_buf,
                             size_t *out_len);

/**
 * @brief Final payload olu?turur
 *
 * @param data_part     "T:xx.x,H:yy.y"
 * @param hmac_hex      64 hex karakter
 * @param out_buf       ??k?? buffer
 * @param out_len       ??k?? uzunlu?u
 * @return true         Ba?ar?l?
 * @return false        Hata
 */
bool payload_build_final(const char *data_part,
                          const char *hmac_hex,
                          char *out_buf,
                          size_t *out_len);
```
